## conf/bblayers.conf.sample
```bitbake
LCONF_VERSION = "7"

BBPATH = "${TOPDIR}"
BSPDIR := "${@os.path.abspath(os.path.dirname(d.getVar('FILE', True)) + '/../..')}"

BBFILES ?= ""
BBLAYERS = " \
  ${BSPDIR}/sources/poky/meta \
  ${BSPDIR}/sources/poky/meta-poky \
  \
  ${BSPDIR}/sources/meta-openembedded/meta-oe \
  ${BSPDIR}/sources/meta-openembedded/meta-multimedia \
  ${BSPDIR}/sources/meta-openembedded/meta-networking \
  ${BSPDIR}/sources/meta-openembedded/meta-python \
  ${BSPDIR}/sources/meta-openembedded/meta-gnome \
  \
  ${BSPDIR}/sources/meta-freescale \
  ${BSPDIR}/sources/meta-freescale-distro \
  \
  ${BSPDIR}/sources/meta-hostmobility-bsp \
  ${BSPDIR}/sources/meta-browser/meta-chromium \
  ${BSPDIR}/sources/meta-clang \
  ${BSPDIR}/sources/meta-mobility-poky-distro \
"

# i.MX Yocto Project Release layers
BBLAYERS += "${BSPDIR}/sources/meta-imx/meta-bsp"
BBLAYERS += "${BSPDIR}/sources/meta-imx/meta-sdk"
```

## conf/distro/fsl-hm-wayland.conf
```bitbake
# i.MX DISTRO for Wayland with X11
include conf/distro/include/fsl-imx-base.inc

DISTRO = "fsl-hm-wayland"
IMX_DEFAULT_BSP = "nxp"

# Remove conflicting backends
DISTRO_FEATURES:remove = "directfb x11 "
DISTRO_FEATURES:append = " wayland pam systemd"

PREFERRED_PROVIDER_linux-imx-mfgtool = "linux-imx-mfgtool"

PREFERRED_VERSION_gstreamer1.0              = "1.24.0.imx"
PREFERRED_VERSION_gstreamer1.0-plugins-base = "1.24.0.imx"
PREFERRED_VERSION_gstreamer1.0-plugins-good = "1.24.0.imx"
PREFERRED_VERSION_gstreamer1.0-plugins-bad  = "1.24.0.imx"
PREFERRED_VERSION_gstreamer1.0-plugins-ugly = "1.24.%"
PREFERRED_VERSION_gstreamer1.0-libav        = "1.24.%"
PREFERRED_VERSION_gstreamer1.0-rtsp-server  = "1.24.%"

PREFERRED_VERSION_gstreamer1.0:mx8-nxp-bsp              = "1.24.0.imx"
PREFERRED_VERSION_gstreamer1.0-plugins-base:mx8-nxp-bsp = "1.24.0.imx"
PREFERRED_VERSION_gstreamer1.0-plugins-good:mx8-nxp-bsp = "1.24.0.imx"
PREFERRED_VERSION_gstreamer1.0-plugins-bad:mx8-nxp-bsp  = "1.24.0.imx"
PREFERRED_VERSION_gstreamer1.0-plugins-ugly:mx8-nxp-bsp = "1.24.%"
PREFERRED_VERSION_gstreamer1.0-libav:mx8-nxp-bsp        = "1.24.%"
PREFERRED_VERSION_gstreamer1.0-rtsp-server:mx8-nxp-bsp  = "1.24.%"

PREFERRED_VERSION_gstreamer1.0:mx9-nxp-bsp              = "1.24.0.imx"
PREFERRED_VERSION_gstreamer1.0-plugins-base:mx9-nxp-bsp = "1.24.0.imx"
PREFERRED_VERSION_gstreamer1.0-plugins-good:mx9-nxp-bsp = "1.24.0.imx"
PREFERRED_VERSION_gstreamer1.0-plugins-bad:mx9-nxp-bsp  = "1.24.0.imx"
PREFERRED_VERSION_gstreamer1.0-plugins-ugly:mx9-nxp-bsp = "1.24.%"
PREFERRED_VERSION_gstreamer1.0-libav:mx9-nxp-bsp        = "1.24.%"
PREFERRED_VERSION_gstreamer1.0-rtsp-server:mx9-nxp-bsp  = "1.24.%"

PREFERRED_VERSION_xen-tools = "4.18.imx+stable"
PREFERRED_VERSION_xen = "4.18.imx+stable"
PREFERRED_VERSION_qemu = "8.2.2.imx"
PREFERRED_VERSION_qemu-native = "8.2.2.imx"
PREFERRED_VERSION_qemu-system-native = "8.2.2.imx"
PREFERRED_VERSION_nativesdk-qemu = "8.2.2.imx"

# Use systemd as default init manager
VIRTUAL-RUNTIME_init_manager = "systemd"
PREFERRED_PROVIDER_udev = "systemd"
PREFERRED_PROVIDER_udev-utils = "systemd"

POKY_DEFAULT_DISTRO_FEATURES += " systemd"

BBMASK += "meta-imx/meta-sdk/recipes-graphics/vulkan"
```

## conf/distro/hm-generic-console.conf
```bitbake
require conf/distro/include/yocto-uninative.inc
require conf/distro/include/security_flags.inc

DISTRO = "hm-generic-console"
DISTRO_NAME = "Host monitor generic console only distro"
DISTRO_VERSION ?= "5.0.7"
DISTRO_CODENAME = "scratchgap"
PACKAGE_CLASSES ?= "package_ipk"
DISTRO_FEATURES = "ipv4 ipv6 systemd usrmerge"
DISTRO_FEATURES_BACKFILL_CONSIDERED = "wifi usbgadget usbhost vfat rtc"

VIRTUAL-RUNTIME_init_manager = "systemd"
PREFERRED_PROVIDER_udev = "systemd"
PREFERRED_PROVIDER_udev-utils = "systemd"

EXTRA_IMAGE_FEATURES += "allow-root-login"

INHERIT += "extrausers"
EXTRA_USERS_PARAMS = "usermod -p '\$6\$I9buqm178Qc8/Hzv\$Y4MEyax.wBDk6cDfyQKbQUcFabIvI.CUyEfRz/x4x.r5gmnQ/PO5ECSxO73b4XMo5YyD5em.HxiYH0iWa7Kxr1' root;"

PREFERRED_VERSION_libgpiod = "1.6%"

#snögubbe
```

## conf/distro/host-insight-poky.conf
```bitbake
DISTRO = "host-insight-poky"
DISTROOVERRIDES = "poky:host-insight-poky"
IMX_DEFAULT_BSP = "mainline"
PACKAGE_CLASSES = 'package_ipk'
EXTRA_IMAGE_FEATURES = "package-management"
require conf/distro/poky.conf
```

## conf/distro/ref-robotframework-poky.conf
```bitbake
DISTRO = "ref-robotframework-poky"
DISTROOVERRIDES = "poky:ref-robotframework-poky"
PACKAGE_CLASSES = 'package_ipk'
EXTRA_IMAGE_FEATURES = "package-management"
DISTRO_FEED_URI += "https://hostmobility.org/robotframework-ref/Package-Manager-REF/${DISTRO}/${DISTRO_CODENAME}-next"
require conf/distro/poky.conf
```

## conf/layer.conf
```bitbake
# Layer configuration for meta-mobility-poky-distro
# Copyright 2020 Host Mobility AB

# We have a conf and classes directory, add to BBPATH
BBPATH .= ":${LAYERDIR}"

# We have recipes-* directories, add to BBFILES
BBFILES += "${LAYERDIR}/recipes-*/*/*.bb \
    ${LAYERDIR}/recipes-*/*/*.bbappend"

BBFILE_COLLECTIONS += "mobility"
BBFILE_PATTERN_mobility = "^${LAYERDIR}/"
BBFILE_PRIORITY_mobility = "91"

LAYERSERIES_COMPAT_mobility = "kirkstone scarthgap"
```

## conf/local.conf.sample
```bitbake
MACHINE ??= 'mx5-pt'
DISTRO ?= 'fslc-x11'
PACKAGE_CLASSES ?= 'package_ipk'
EXTRA_IMAGE_FEATURES ?= "debug-tweaks"
USER_CLASSES ?= "buildstats image-mklibs image-prelink"
PATCHRESOLVE = "noop"
BB_DISKMON_DIRS ??= "\
    STOPTASKS,${TMPDIR},1G,100K \
    STOPTASKS,${DL_DIR},1G,100K \
    STOPTASKS,${SSTATE_DIR},1G,100K \
    STOPTASKS,/tmp,100M,100K \
    ABORT,${TMPDIR},100M,1K \
    ABORT,${DL_DIR},100M,1K \
    ABORT,${SSTATE_DIR},100M,1K \
    ABORT,/tmp,10M,1K"
PACKAGECONFIG_append_pn-qemu-system-native = " sdl"
PACKAGECONFIG_append_pn-nativesdk-qemu = " sdl"
CONF_VERSION = "1"
ACCEPT_FSL_EULA = "1"

INHERIT += "rm_work"

# Remove conflicting backends.
DISTRO_FEATURES_remove = "vulkan "

DISTRO_FEATURES_append = " systemd"
VIRTUAL-RUNTIME_init_manager = "systemd"
DISTRO_FEATURES_BACKFILL_CONSIDERED = "sysvinit"
VIRTUAL-RUNTIME_initscripts = ""

LICENSE_FLAGS_WHITELIST = "commercial"

DISTRO_FEED_PREFIX += "mobility"
DISTRO_FEED_URI += "http://www.hostmobility.org:8008/ipk_bsp2/mobility"
DISTRO_FEED_ARCHS += "all ${PACKAGE_EXTRA_ARCHS} ${MACHINE_ARCH}"

ERROR_QA_remove = "version-going-backwards"
```
